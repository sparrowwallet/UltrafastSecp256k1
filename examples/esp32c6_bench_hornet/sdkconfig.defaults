## examples/esp32c6_bench_hornet/sdkconfig.defaults
```kconfig
# Target: ESP32-C6 (RISC-V single-core, 160 MHz)
CONFIG_IDF_TARGET="esp32c6"

# Optimizer - performance for accurate benchmarks
CONFIG_COMPILER_OPTIMIZATION_PERF=y
CONFIG_ESP_DEFAULT_CPU_FREQ_MHZ_160=y

# Stack sizes (crypto needs more stack)
CONFIG_ESP_MAIN_TASK_STACK_SIZE=32768

# Flash size
CONFIG_ESPTOOLPY_FLASHSIZE_4MB=y

# Logging
CONFIG_BOOTLOADER_LOG_LEVEL_WARN=y
CONFIG_LOG_DEFAULT_LEVEL_INFO=y

# IPC task stack
CONFIG_ESP_IPC_TASK_STACK_SIZE=4096

# Disable IDLE watchdog (long benchmarks)
CONFIG_ESP_TASK_WDT_CHECK_IDLE_TASK_CPU0=n
```
